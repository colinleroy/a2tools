HGR_HEIGHT         = 192

MID_BOARD          = HGR_HEIGHT/2

MY_PUSHER_MIN_X    = 0
MY_PUSHER_MAX_X    = 224
MY_PUSHER_MIN_Y    = 154
MY_PUSHER_MAX_Y    = HGR_HEIGHT
MY_PUCK_INI_Y      = 156

MY_PUSHER_INI_X    = 116
MY_PUSHER_INI_Y    = MY_PUSHER_MAX_Y

THEIR_PUSHER_MIN_X = 0
THEIR_PUSHER_MAX_X = 224
THEIR_PUSHER_MIN_Y = 7
THEIR_PUSHER_MAX_Y = 43
THEIR_PUCK_INI_Y   = 42

THEIR_PUSHER_INI_X = 116
THEIR_PUSHER_INI_Y = THEIR_PUSHER_MIN_Y

PUCK_MIN_X         = 0
PUCK_MAX_X         = 249
PUCK_MIN_Y         = 1
PUCK_MAX_Y         = 192

PUCK_INI_X         = 124

ABS_MAX_DX         = $18
ABS_MAX_DY         = $18

MAX_SCORE          = 15

CH_ESC             = $1B
NUM_OPPONENTS      = 8      ; DC3 doesn't tournament

; scores drawing

SCORE_VERTICAL_LINE_LEN = 7
SCORE_DIAGONAL_LINE_LEN = 5
SCORE_VERTICAL_X_OFFSET = 0
SCORE_DIAGONAL_X_OFFSET = 2
SCORE_VERTICAL_START_Y  = 23
SCORE_DIAGONAL_START_Y  = 22

; Number of people in the roster
MAX_WINNERS = 32
; 12 chars for the name (incl. terminator)
MAX_WINNER_LEN = 12
