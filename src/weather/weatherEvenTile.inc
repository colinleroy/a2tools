;sunny
.byte $80,$C0,$80,$80
.byte $88,$C0,$80,$84
.byte $A0,$80,$80,$81
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.byte $80,$C0,$80,$80
; few clouds
.byte $80,$81,$80,$80
.byte $80,$81,$80,$80
.byte $82,$90,$80,$80
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.byte $80,$80,$80,$80
; scattered clouds
.byte $00,$00,$00,$00
.byte $00,$00,$00,$00
.byte $00,$00,$00,$00
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.byte $00,$00,$00,$00
; broken clouds
.byte $00,$00,$00,$00
.byte $00,$00,$00,$00
.byte $00,$8A,$80,$80
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.byte $00,$00,$00,$00
; shower
.byte $80,$80,$80,$80
.byte $F0,$81,$80,$80
.byte $F8,$87,$80,$80
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.byte $C1,$A0,$C4,$80
; rain
.byte $A0,$80,$80,$80
.byte $82,$80,$80,$80
.byte $A8,$84,$80,$80
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.byte $84,$82,$91,$82
; thunder storm
.byte $00,$00,$00,$00
.byte $70,$01,$00,$00
.byte $78,$07,$00,$00
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.byte $00,$08,$00,$00
; snow
.byte $00,$00,$00,$00
.byte $70,$01,$00,$00
.byte $78,$07,$00,$00
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.byte $66,$18,$33,$00
; mist
.byte $00,$00,$00,$00
.byte $E0,$CC,$99,$83
.byte $80,$80,$80,$80
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.byte $98,$E6,$F0,$81
; sunrise , sunset
.byte $80,$80,$80,$8C
.byte $80,$84,$80,$9E
.byte $88,$C0,$80,$BF
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.byte $55,$2A,$05,$8C
