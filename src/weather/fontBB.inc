 .byte   $10,$08,$36,$7F,$3F,$3F,$7E,$36 ;'@'^
    .byte   $10,$08,$36,$41,$21,$21,$4A,$36 ;'A'^
    .byte   $00,$00,$02,$06,$0E,$1E,$36,$42 ;'B'^
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 	.byte   $00,$1c,$33,$1c,$00,$00,$00,$00 ;'degree
;	.byte $b6,$b6,$a4,$b6,$80,$80,$80,$80 ; No= 2 
	.byte $00,$c0,$c0,$c0,$d4,$d0,$c0,$ff ; min 1 (shift 3)
	.byte $00,$82,$82,$82,$aa,$8a,$82,$ff ; min 2 (shift 4)
;	.byte $9e,$9e,$bf,$9e,$bf,$9e,$9e,$80 ; No= 3
;	.byte $8c,$be,$83,$9e,$b0,$9f,$8c,$80 ; No= 4
	.byte $b7,$b7,$98,$8c,$86,$bb,$bb,$80 ; No= 5 %
	.byte $ff,$a0,$a8,$aa,$a0,$a0,$a0,$00 ; max 1 (shift 6)
	.byte $ff,$81,$85,$95,$81,$81,$81,$00 ; max 2 (shift 7)
	.byte $b0,$7c,$fe,$ff,$90,$84,$c1,$90 ; per 1 (shift 8)
	.byte $00,$18,$bf,$ff,$88,$82,$a0,$88 ; per 2 (shift 9)
;	.byte $86,$8f,$86,$8f,$bb,$9b,$ae,$80 ; No= 6
;	.byte $8c,$8c,$88,$8c,$80,$80,$80,$80 ; No= 7
;	.byte $b8,$9c,$8e,$8e,$8e,$9c,$b8,$80 ; No= 8
;	.byte $87,$8e,$9c,$9c,$9c,$8e,$87,$80 ; No= 9
	.byte $88,$aa,$9c,$be,$9c,$aa,$88,$80 ; No=10
	.byte $8c,$8c,$bf,$bf,$8c,$8c,$80,$80 ; No=11
	.byte $80,$80,$80,$80,$80,$87,$86,$83 ; No=12
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	.byte $86,$bf,$98,$80,$80,$80,$80,$80 ; No=94
