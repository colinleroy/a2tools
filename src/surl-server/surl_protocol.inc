; Update in .h too!
SURL_PROTOCOL_VERSION       = 21

SURL_METHOD_ABORT           = ('d'|$80)
SURL_METHOD_RAW             = $05
SURL_METHOD_GET             = $06
SURL_METHOD_POST            = $07
SURL_METHOD_PUT             = $08
SURL_METHOD_DELETE          = $09
SURL_METHOD_POST_DATA       = $10
SURL_METHOD_GETTIME         = $11
SURL_METHOD_PING            = $12
SURL_METHOD_DEBUG           = $13
SURL_METHOD_STREAM_VIDEO    = $14
SURL_METHOD_STREAM_AUDIO    = $15
SURL_METHOD_STREAM_AV       = $16
SURL_METHOD_DUMP            = $17

SURL_ANSWER_WAIT            = $20
SURL_ANSWER_SEND_SIZE       = $21
SURL_ANSWER_RAW_START       = $22
SURL_ANSWER_SEND_NUM_FIELDS = $23
SURL_ANSWER_TIME            = $24
SURL_ANSWER_PONG            = $25
SURL_ANSWER_STREAM_ERROR    = $26
SURL_ANSWER_STREAM_START    = $27
SURL_ANSWER_STREAM_LOAD     = $28
SURL_ANSWER_STREAM_READY    = $29
SURL_ANSWER_STREAM_ART      = $2A
SURL_ANSWER_STREAM_METADATA = $2B

SURL_CLIENT_READY           = $2F

SURL_CMD_SEND               = $30
SURL_CMD_HEADERS            = $31
SURL_CMD_FIND               = $32
SURL_CMD_JSON               = $33
SURL_CMD_HGR                = $34
SURL_CMD_STRIPHTML          = $35
SURL_CMD_TRANSLIT           = $36
SURL_CMD_SKIP               = $37
SURL_CMD_FIND_HEADER        = $38

SURL_ERROR_OK               = $40
SURL_ERROR_NOT_FOUND        = $41
SURL_ERROR_NOT_JSON         = $42
SURL_ERROR_CONV_FAILED      = $43

SURL_UPLOAD_GO              = $50
SURL_UPLOAD_PARAM_ERROR     = $51

SURL_DATA_X_WWW_FORM_URLENCODED_HELP = 0
SURL_DATA_X_WWW_FORM_URLENCODED_RAW  = 1
SURL_DATA_APPLICATION_JSON_HELP      = 2

SURL_HTMLSTRIP_NONE       = 0
SURL_HTMLSTRIP_FULL       = 1
SURL_HTMLSTRIP_WITH_LINKS = 2

HGR_SCALE_FULL     = 0
HGR_SCALE_HALF     = 1
HGR_SCALE_MIXHGR   = 2


SUBTITLES_NO       = 0
SUBTITLES_AUTO     = 1
SUBTITLES_URL      = 2

SURL_VIDEO_PORT_OK  = 0
SURL_VIDEO_PORT_NOK = 1

SURL_HTTP_CONTINUE           = 100
SURL_HTTP_OK                 = 200

SURL_ERR_TIMEOUT             = 504
SURL_ERR_PROTOCOL_ERROR      = 508
SURL_ERR_PROXY_NOT_CONNECTED = 600
