audio_status_patches:
                .word ass
                .word asp
                .word $0000

; -----------------------------------------------------------------
audio_data_patches:
                .word ads
                .word adp
                .word ad0
                .word ad0b
                .word ad1
                .word ad1b
                .word ad2
                .word ad2b
                .word ad3
                .word ad3b
                .word ad4
                .word ad4b
                .word ad5
                .word ad5b
                .word ad6
                .word ad6b
                .word ad7
                .word ad7b
                .word ad8
                .word ad8b
                .word ad9
                .word ad9b
                .word ad10
                .word ad10b
                .word ad11
                .word ad11b
                .word ad12
                .word ad12b
                .word ad13
                .word ad13b
                .word ad14
                .word ad14b
                .word ad15
                .word ad15b
                .word ad16
                .word ad16b
                .word ad17
                .word ad17b
                .word ad18
                .word ad18b
                .word ad19
                .word ad19b
                .word ad20
                .word ad20b
                .word ad21
                .word ad21b
                .word ad22
                .word ad22b
                .word ad23
                .word ad23b
                .word ad24
                .word ad24b
                .word ad25
                .word ad25b
                .word ad26
                .word ad26b
                .word ad27
                .word ad27b
                .word ad28
                .word ad28b
                .word ad29
                .word ad29b
                .word ad30
                .word ad30b
                .word ad31
                .word ad31b
                .word $0000
